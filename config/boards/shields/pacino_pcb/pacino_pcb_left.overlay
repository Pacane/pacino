#include "pacino_pcb.dtsi"

/*
 * Left half: sockets and diodes on the board's BACK face, controller on the FRONT (on top of the
 * board, component side down).  Seen from the front that puts the nano's RAW row on pads 13-24 and
 * its TX row on pads 1-12.  Bridge JP1 / JP2 to the pad marked L, on the face the nano sits on.
 */

&kscan0 {
    row-gpios
        = <&pro_micro 2 (GPIO_ACTIVE_HIGH | GPIO_PULL_DOWN)>    /* row 0: top    */
        , <&pro_micro 3 (GPIO_ACTIVE_HIGH | GPIO_PULL_DOWN)>    /* row 1: home   */
        , <&pro_micro 4 (GPIO_ACTIVE_HIGH | GPIO_PULL_DOWN)>    /* row 2: bottom */
        , <&pro_micro 5 (GPIO_ACTIVE_HIGH | GPIO_PULL_DOWN)>    /* row 3: extras */
        , <&pro_micro 9 (GPIO_ACTIVE_HIGH | GPIO_PULL_DOWN)>    /* row 4: thumbs */
        ;
    /* COL0 .. COL4 = pinky .. inner, the order the transform wants for the left half */
    col-gpios
        = <&pro_micro 21 GPIO_ACTIVE_HIGH>   /* col 0: pinky  (COL0) */
        , <&pro_micro 20 GPIO_ACTIVE_HIGH>   /* col 1: ring   (COL1) */
        , <&pro_micro 19 GPIO_ACTIVE_HIGH>   /* col 2: middle (COL2) */
        , <&pro_micro 18 GPIO_ACTIVE_HIGH>   /* col 3: index  (COL3) */
        , <&pro_micro 10 GPIO_ACTIVE_HIGH>   /* col 4: inner  (COL4) */
        ;
};
