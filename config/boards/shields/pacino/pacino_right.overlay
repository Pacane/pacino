#include "pacino.dtsi"

&default_transform {
    col-offset = <5>;
};

&kscan0 {
    col-gpios
        = <&pro_micro 5 GPIO_ACTIVE_HIGH>    /* col 5: inner  */
        , <&pro_micro 6 GPIO_ACTIVE_HIGH>    /* col 6: index  */
        , <&pro_micro 7 GPIO_ACTIVE_HIGH>    /* col 7: middle */
        , <&pro_micro 8 GPIO_ACTIVE_HIGH>    /* col 8: ring   */
        , <&pro_micro 9 GPIO_ACTIVE_HIGH>    /* col 9: pinky  */
        ;
};
