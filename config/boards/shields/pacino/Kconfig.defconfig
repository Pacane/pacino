## config/boards/shields/pacino/Kconfig.defconfig
```kconfig
if SHIELD_PACINO_LEFT

config ZMK_KEYBOARD_NAME
	default "Pacino"

config ZMK_SPLIT_ROLE_CENTRAL
	default y

endif

if SHIELD_PACINO_LEFT || SHIELD_PACINO_RIGHT

config ZMK_SPLIT
	default y

endif
```

## config/boards/shields/pacino/Kconfig.shield
```kconfig
config SHIELD_PACINO_LEFT
	def_bool $(shields_list_contains,pacino_left)

config SHIELD_PACINO_RIGHT
	def_bool $(shields_list_contains,pacino_right)
```

## config/boards/shields/pacino_pcb/Kconfig.defconfig
```kconfig
if SHIELD_PACINO_PCB_LEFT

config ZMK_KEYBOARD_NAME
	default "Pacino"

config ZMK_SPLIT_ROLE_CENTRAL
	default y

endif

if SHIELD_PACINO_PCB_LEFT || SHIELD_PACINO_PCB_RIGHT

config ZMK_SPLIT
	default y

endif
```

## config/boards/shields/pacino_pcb/Kconfig.shield
```kconfig
config SHIELD_PACINO_PCB_LEFT
	def_bool $(shields_list_contains,pacino_pcb_left)

config SHIELD_PACINO_PCB_RIGHT
	def_bool $(shields_list_contains,pacino_pcb_right)
```
